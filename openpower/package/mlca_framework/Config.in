## openpower/package/mlca_framework/Config.in
```kconfig
config BR2_PACKAGE_HOST_MLCA_FRAMEWORK
        bool "MLCA framework signing library"
        default y if (BR2_OPENPOWER_PLATFORM)
        help
            MLCA PQC library for signing OpenPOWER firmware images
```
